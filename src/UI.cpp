/*
UI.cpp - User Interface Core for the Maauw Extensions Pyrometer
Copyright (c) 2019 Syby Abraham.
*/

#include "UI.h"

UI::UI(){
	_state = 1;
	_time = 0;
	_displayState = 1;
	_animFrame = 0;

	_prevDR = core.getCardState;
}

//Create Popup Window
void UI::createPopup(char msg[], int duration) {

	switch (_state){

	case 1:
		_time = millis(); //Capture Clock
		_state = 2;
		break;

	case 2:
		if (millis() - _time < duration) {  //Use captured time to see if time has passed
			//Message Box
			u8g2.setDrawColor(0);
			u8g2.drawBox(14, 24, 100, 80);
			u8g2.setDrawColor(1);
			u8g2.drawFrame(14, 24, 100, 80);

			//Message Text  
			u8g2.setFont(u8g2_font_helvB08_tf);
			u8g2.drawStr(center(msg), 64, msg);
		}
		else {
			_state = 1;
		}
	}
}

void UI::sdPopupHandler(){
	if (_state == 1) {
	_callback = 0;
}

if (_prevDR != core.getCardState){
	_prevDR = core.getCardState;
	_callback = 1;
}

if (_callback == 1 && digitalRead(PB7) == 0) {
	createPopup("SD Inserted", 1500);
} else if (_callback == 1 && digitalRead(PB7) == 1) {
	createPopup("SD Ejected", 1500);
	}
}

void UI::shutdownScreen() {
	u8g2.clearBuffer();
	u8g2.drawXBMP(4, 37, maauw_ext_width, maauw_ext_height, maauw_ext_bits);
	u8g2.setFont(u8g2_font_helvB08_tf);
	u8g2.drawStr(29.5, 100, "Shutting Down");
	u8g2.sendBuffer();
	delay(2000);
}




void UI::fireAnimation(int x, int y) {

	switch(_animFrame){
		
		case 0:
			_animClock = millis();
			_animFrame = 1; 
			
		case 1:	
			if (millis() - _animClock > frameRate) {
				_animClock = millis();
				_animFrame = 2;
				u8g2.drawXBM(x, y, fire_width, fire_height, fire_02_bits);

			} else {
				u8g2.drawXBM(x, y, fire_width, fire_height, fire_01_bits);
			}
			break;
		case 2:
			if (millis() - _animClock > frameRate) {
				_animClock = millis();
				_animFrame = 3;
				u8g2.drawXBM(x, y, fire_width, fire_height, fire_03_bits);
			}
			else {
				u8g2.drawXBM(x, y, fire_width, fire_height, fire_02_bits);
			}
			break;
		case 3:
			if (millis() - _animClock > frameRate) {
				_animClock = millis();
				_animFrame = 4;
				u8g2.drawXBM(x, y, fire_width, fire_height, fire_04_bits);
			}
			else {
				u8g2.drawXBM(x, y, fire_width, fire_height, fire_03_bits);
			}
			break;
		case 4:
			if (millis() - _animClock > frameRate) {
				_animClock = millis();
				_animFrame = 5;
				u8g2.drawXBM(x, y, fire_width, fire_height, fire_05_bits);

			}
			else {
				u8g2.drawXBM(x, y, fire_width, fire_height, fire_04_bits);
			}
			break;
		case 5:
			if (millis() - _animClock > frameRate) {
				_animClock = millis();
				_animFrame = 6;
				u8g2.drawXBM(x, y, fire_width, fire_height, fire_06_bits);

			}
			else {
				u8g2.drawXBM(x, y, fire_width, fire_height, fire_05_bits);
			}
			break;
		case 6:
			if (millis() - _animClock > frameRate) {
				_animClock = millis();
				_animFrame = 7;
				u8g2.drawXBM(x, y, fire_width, fire_height, fire_07_bits);
			}
			else {
				u8g2.drawXBM(x, y, fire_width, fire_height, fire_06_bits);
			}
			break;
		case 7:
			if (millis() - _animClock > frameRate) {
				_animClock = millis();
				_animFrame = 8;
				u8g2.drawXBM(x, y, fire_width, fire_height, fire_08_bits);
			}
			else {
				u8g2.drawXBM(x, y, fire_width, fire_height, fire_07_bits);
			}
			break;
		case 8:
			if (millis() - _animClock > frameRate) {
				_animClock = millis();
				_animFrame = 9;
				u8g2.drawXBM(x, y, fire_width, fire_height, fire_09_bits);
			}
			else {
				u8g2.drawXBM(x, y, fire_width, fire_height, fire_08_bits);
			}
			break;
		case 9:
			if (millis() - _animClock > frameRate) {
				_animClock = millis();
				_animFrame = 10;
				u8g2.drawXBM(x, y, fire_width, fire_height, fire_10_bits);
			}
			else {
				u8g2.drawXBM(x, y, fire_width, fire_height, fire_09_bits);
			}
			break;
		case 10:
			if (millis() - _animClock > frameRate) {
				_animClock = millis();
				_animFrame = 11;
				u8g2.drawXBM(x, y, fire_width, fire_height, fire_11_bits);
			}
			else {
				u8g2.drawXBM(x, y, fire_width, fire_height, fire_10_bits);
			}
			break;
		case 11:
			if (millis() - _animClock > frameRate) {
				_animClock = millis();
				_animFrame = 12;
				u8g2.drawXBM(x, y, fire_width, fire_height, fire_12_bits);
			}
			else {
				u8g2.drawXBM(x, y, fire_width, fire_height, fire_11_bits);
			}
			break;
		case 12:
			if (millis() - _animClock > frameRate) {
				_animClock = millis();
				_animFrame = 1;
				u8g2.drawXBM(x, y, fire_width, fire_height, fire_01_bits);
			}
			else {
				u8g2.drawXBM(x, y, fire_width, fire_height, fire_12_bits);
			}
			break;
	}
}

void UI::powerOff() {
	_displayState = 3;
}

void UI::powerSave() {
	_displayState = 2;
}

void UI::normal() {
	_displayState = 1;
}

void UI::displayCone() {
	String strC;
	float coneLCD = cone.getCone(core.getTemp());
	int intConeLCD;                                     //Int variable to strip the decimal point
	if (coneLCD == -255) {                              //Temp Lower than lowest cone
		strC = (String("LOW"));
	}
	else if (coneLCD != -255 && coneLCD != -5.5 && (coneLCD < 0)) {
		intConeLCD = coneLCD * -1;                       //Multiply by -1 to convert to a positive integer
		strC = (String(0) + String(intConeLCD));         //Replace the negative sign with a 0
	}
	/*else if (coneLCD == -5.5) {
	 strC = String("05\xbd");
   }
   else if (coneLCD == 5.5) { //Commented out since 1/2 symobls are missing in the selected font
	 strC = String("5\xbd");
   }*/
	else if (coneLCD >= 0 && coneLCD <= 14) {
		intConeLCD = coneLCD;
		strC = String(intConeLCD);
	}
	else if (coneLCD == 15) {
		strC = (String(15) + String("+"));
	}

	char coneChar[5];
	convertToChar(strC, coneChar);

	//Cone Readout
	u8g2.setFont(u8g2_font_logisoso38_tf);
	u8g2.drawStr((16 + center(coneChar)), 79, coneChar);
	u8g2.drawXBMP((center(coneChar) - 16), 42, cone_width, cone_height, cone_bits);
}

void UI::battIcon() {

	//Charging Animation
	if (charge < 21) {
		charge++;

	}
	else if (charge == 21) {
		charge = 0;
	};

	//charge = map(core.getVolt(), 3.3, 4.2, 0, 21);
	//charge = 21; 

	//Battery Icon
	u8g2.drawFrame(101, 5, 25, 10);
	u8g2.drawBox(103, 7, charge, 6); //Charge Indicator  
	u8g2.drawBox(126, 7, 2, 6);
}

//Temperature Readout
void UI::showTemp(bool mode){
	char tempRead[7];
	int temp1;
	temp1 = core.getTemp();
	if (_unit == !true) {
		temp1 = 1.8 * core.getTemp() + 32;
		convertToChar(String(temp1) + String("\xb0\F"), tempRead); //Convert to char and store in above var
	}
	else {
		convertToChar(String(temp1) + String("\xb0\C"), tempRead); //Convert to char and store in above var
	}

		if (mode == !true) {
			u8g2.setFont(u8g2_font_logisoso26_tf);
			if (isnan(core.getTemp())) {
				u8g2.setFont(u8g2_font_crox3h_tr);
				u8g2.drawStr(center("Thermocouple"), 107, "Thermocouple");
				u8g2.drawStr(center("Disconnected"), 125, "Disconnected");
			}
			else {
				u8g2.drawStr(center(tempRead), 120, (tempRead));
			}
		}
		else {
			u8g2.setFont(u8g2_font_helvB08_tf);
			if (isnan(core.getTemp())) {
				u8g2.drawStr(center("Error"), 64, ("Error"));
			}
			else {
				u8g2.drawStr(center(tempRead), 64, (tempRead));
			}
		}
}

int UI::getDisplayState() {
	return _displayState;
}

int UI::getUnit() {
	return _unit;
}

int UI::setUnit(int unit) {
	_unit = unit; 
}

int UI::center(char input[]) {
	int xVal = ((128 - u8g2.getStrWidth(input)) / 2);
	return xVal;
}

//String to char array conversion
void UI::convertToChar(String str, char outChar[]) {
	int16_t str_len = str.length() + 1;
	char convChar[str_len];
	str.toCharArray(convChar, str_len);
	strcpy(outChar, convChar);
}

void UI::loader(int load){
u8g2.drawBox(12, 87, load, 6);
u8g2.drawXBMP(4, 37, maauw_ext_width, maauw_ext_height, maauw_ext_bits);
u8g2.sendBuffer();
}

void UI::run(void) {
	
	if (_displayState == 1) {
		u8g2.clearBuffer();

		//Pyrometer Text
		u8g2.setFont(u8g2_font_helvB08_tf);
		if(tempChange() > 0) {  //Positive rate change
			u8g2.drawStr(0, 14, "Heating");
		} else if (tempChange() < 0) { //Negative rate change
			u8g2.drawStr(0, 14, "Cooling");
		}
		else { //Zero rate change
			u8g2.drawStr(0, 14, "Idle");
		}

		//Logging Indicator Text
		u8g2.setFont(u8g2_font_helvB08_tf);
		u8g2.drawStr(58, 14, "Log");

		//Battery Icon
		battIcon();

		//Line
		u8g2.drawLine(0, 25, 128, 25);

		// Display Cone
		displayCone();

		showTemp(0);

		fireAnimation(9, 90);

		sdPopupHandler();
		///Send Created Buffer
		u8g2.sendBuffer();
	}
	else if (_displayState == 2) {
		//LOW Power Mode
		u8g2.clearBuffer();
		showTemp(1);
		u8g2.sendBuffer();
	}
	else if (_displayState == 3) {
		shutdownScreen();
	}
}

const unsigned char PROGMEM UI::cone_bits[] = {
  0x00, 0x40, 0x00, 0x00, 0x00, 0xE0, 0x00, 0x00, 0x00, 0xE0, 0x00, 0x00,
  0x00, 0xF0, 0x01, 0x00, 0x00, 0xF0, 0x01, 0x00, 0x00, 0xF8, 0x01, 0x00,
  0x00, 0xF8, 0x03, 0x00, 0x00, 0xF8, 0x03, 0x00, 0x00, 0xFC, 0x07, 0x00,
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  0xFF, 0xFF, 0xFF, 0x1F, 0xFF, 0xFF, 0xFF, 0x1F, };

const unsigned char PROGMEM UI::maauw_ext_bits[] = {
0xF0, 0x01, 0xF0, 0x01, 0x00, 0x00, 0x00, 0x00, 0x00, 0x00, 0x00, 0x00,
  0x00, 0x00, 0x00, 0xF0, 0x01, 0xF8, 0x01, 0x00, 0x00, 0x00, 0x00, 0x00,
  0x00, 0x00, 0x00, 0x00, 0x00, 0x00, 0xF0, 0x03, 0xF8, 0x01, 0x00, 0x00,
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  0xF8, 0x00, 0x00, 0x00, 0x00, 0x00, };

const unsigned char PROGMEM UI::alpha_bits[] = {
  0xDC, 0xFE, 0x63, 0x63, 0x63, 0x73, 0xFF, 0xCE, };

const unsigned char PROGMEM UI::beta_bits[] = {
  0x3C, 0x7E, 0x67, 0x63, 0x3B, 0x7B, 0xE3, 0xC3, 0xE3, 0x7F, 0x3F, 0x03,
  0x03, 0x03, };

const unsigned char UI::fire_01_bits[] = {
  0x00, 0x00, 0x00, 0x00, 0x00, 0x00, 0x00, 0x00, 0x00, 0x00, 0x00, 0x08,
  0x04, 0x06, 0x06, 0x16, 0x26, 0x36, 0x3E, 0x3E, 0x3E, 0x3F, 0x7F, 0x7F,
  0x7F, 0x7F, 0x3E, 0x1C, };

const unsigned char UI::fire_02_bits[] U8X8_PROGMEM = {
  0x00, 0x00, 0x00, 0x00, 0x00, 0x00, 0x00, 0x00, 0x08, 0x04, 0x06, 0x06,
  0x02, 0x02, 0x04, 0x00, 0x00, 0x04, 0x0C, 0x2E, 0x3E, 0x3E, 0x7F, 0x7F,
  0x7F, 0x7F, 0x3E, 0x1C, };

const unsigned char UI::fire_03_bits[] U8X8_PROGMEM = {
  0x00, 0x00, 0x00, 0x04, 0x04, 0x02, 0x02, 0x00, 0x00, 0x00, 0x00, 0x00,
  0x00, 0x00, 0x00, 0x10, 0x30, 0x30, 0x30, 0x3A, 0x3E, 0x7E, 0x7E, 0x7F,
  0x7F, 0x7F, 0x3E, 0x1C, };

const unsigned char UI::fire_04_bits[] U8X8_PROGMEM = {
  0x02, 0x02, 0x00, 0x00, 0x00, 0x00, 0x00, 0x00, 0x00, 0x00, 0x00, 0x10,
  0x30, 0x30, 0x30, 0x30, 0x38, 0x38, 0x38, 0x7C, 0x7C, 0x7E, 0x7E, 0x7F,
  0x7F, 0x7F, 0x3E, 0x1C, };

const unsigned char UI::fire_05_bits[] U8X8_PROGMEM = {
  0x00, 0x00, 0x00, 0x00, 0x00, 0x00, 0x10, 0x10, 0x10, 0x30, 0x30, 0x30,
  0x20, 0x00, 0x00, 0x00, 0x10, 0x30, 0x7A, 0x7E, 0x7E, 0x7E, 0x7E, 0x7F,
  0x7F, 0x7F, 0x3E, 0x1C, };

const unsigned char UI::fire_06_bits[] U8X8_PROGMEM = {
  0x00, 0x00, 0x10, 0x10, 0x00, 0x20, 0x20, 0x00, 0x00, 0x00, 0x00, 0x00,
  0x00, 0x00, 0x02, 0x02, 0x26, 0x2E, 0x6E, 0x7E, 0x7E, 0x7F, 0x7F, 0x7F,
  0x7F, 0x7F, 0x3E, 0x1C, };

const unsigned char PROGMEM UI::fire_07_bits[] = {
  0x00, 0x00, 0x00, 0x00, 0x00, 0x00, 0x00, 0x00, 0x00, 0x00, 0x00, 0x08,
  0x10, 0x30, 0x30, 0x34, 0x32, 0x36, 0x3E, 0x3E, 0x3E, 0x7E, 0x7F, 0x7F,
  0x7F, 0x7F, 0x3E, 0x1C, };

const unsigned char PROGMEM UI::fire_08_bits[] = {
  0x00, 0x00, 0x00, 0x00, 0x00, 0x00, 0x00, 0x00, 0x08, 0x10, 0x30, 0x30,
  0x20, 0x20, 0x10, 0x00, 0x00, 0x10, 0x18, 0x3A, 0x3E, 0x3E, 0x7F, 0x7F,
  0x7F, 0x7F, 0x3E, 0x1C, };

const unsigned char PROGMEM UI::fire_09_bits[] = {
  0x00, 0x00, 0x00, 0x10, 0x10, 0x20, 0x20, 0x00, 0x00, 0x00, 0x00, 0x00,
  0x00, 0x00, 0x00, 0x04, 0x06, 0x06, 0x06, 0x2E, 0x3E, 0x3F, 0x3F, 0x7F,
  0x7F, 0x7F, 0x3E, 0x1C, };

const unsigned char PROGMEM UI::fire_10_bits[] = {
  0x20, 0x20, 0x00, 0x00, 0x00, 0x00, 0x00, 0x00, 0x00, 0x00, 0x00, 0x04,
  0x06, 0x06, 0x06, 0x06, 0x0E, 0x0E, 0x0E, 0x1F, 0x1F, 0x3F, 0x3F, 0x7F,
  0x7F, 0x7F, 0x3E, 0x1C, };

const unsigned char PROGMEM UI::fire_11_bits[] = {
  0x00, 0x00, 0x00, 0x00, 0x00, 0x00, 0x04, 0x04, 0x04, 0x06, 0x06, 0x06,
  0x02, 0x00, 0x00, 0x00, 0x04, 0x06, 0x2F, 0x3F, 0x3F, 0x3F, 0x3F, 0x7F,
  0x7F, 0x7F, 0x3E, 0x1C, };

const unsigned char PROGMEM UI::fire_12_bits[] = {
  0x00, 0x00, 0x04, 0x04, 0x00, 0x02, 0x02, 0x00, 0x00, 0x00, 0x00, 0x00,
  0x00, 0x00, 0x20, 0x20, 0x32, 0x3A, 0x3B, 0x3F, 0x3F, 0x7F, 0x7F, 0x7F,
  0x7F, 0x7F, 0x3E, 0x1C, };